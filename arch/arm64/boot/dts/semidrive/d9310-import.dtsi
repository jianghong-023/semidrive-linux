/*
* Semidrive D9 platform DTS file
*
* Copyright (C) 2019, Semidrive  Communications Inc.
*
* This file is licensed under a dual GPLv2 or X11 license.
*/

/*Note: add safety/rtc imported resources here!*/

/ {
	soc{

		ospi1: spi@30020000 {
			compatible = "sdrv,ospi-nor";
			#address-cells = <1>;
			#size-cells = <0>;
			reg = <0 0x30020000 0 0x10000>,
				<0 0x4000000 0 0x4000000>;
			interrupts = <GIC_SPI 56 IRQ_TYPE_LEVEL_HIGH>;
			cdns,fifo-depth = <256>;
			cdns,fifo-width = <4>;
			cdns,trigger-address = <0x3fffe00>;
			clocks = <&OSPI1>;
			status = "disabled";
		};

		rtc: rtc@0x31810000 {
			compatible = "semidrive,sdrv-rtc";
			reg = <0x0 0x31810000 0x0 0x10000>;
			interrupts = <0 220 IRQ_TYPE_LEVEL_HIGH>;
			status = "disabled";
		};

	};
};
