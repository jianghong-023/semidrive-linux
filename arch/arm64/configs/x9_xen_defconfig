## drivers/thermal/semidrive_pvt/Kconfig
```kconfig
menu "semidrive thermal pvt cooling device drivers"
source "drivers/thermal/semidrive_pvt/semidrive_budget_cooling/Kconfig"
endmenu

menu "semidrive thermal pvt sensor drivers"
source "drivers/thermal/semidrive_pvt/semidrive_thermal/Kconfig"
endmenu
```

## drivers/thermal/semidrive_pvt/semidrive_thermal/Kconfig
```kconfig
config SEMIDRIVE_PVT_SENSOR
	tristate "PVT Thermal sensor driver"
	depends on ARCH_SEMIDRIVE
	help
	PVT Thermal sensor on SEMIDRIVE platform.

config SEMIDRIVE_PVT_DRIVER
	tristate "Thermal sensor driver for SEMIDRIVE platform"
	depends on SEMIDRIVE_PVT_SENSOR
	help
	Temperature pvt sensor on semidrive soc platform. The pvt thermal sensor driver used to
	get temp.
```

## sound/soc/semidrive/Kconfig
```kconfig
menu "SoC Audio for Semidrive Chips"

comment "Common SoC Audio options for Semidrive Chips"

config SND_SDRV_AFE_I2S_SC
	tristate "ASoC Audio driver for x9 i2s sc"
	select REGMAP_MMIO

config SND_SDRV_AFE_I2S_MC
	tristate "ASoC Audio driver for x9 i2s mc"
	select REGMAP_MMIO

config SND_X9_FPGA_MACH
	tristate "ASoC Audio driver for fpga platform x9 with cs24888 codec"
	depends on ARCH_SEMIDRIVE_X9
	select SND_SDRV_AFE_I2S_SC
	select SND_SDRV_AFE_I2S_MC
	select SND_SOC_GENERIC_DMAENGINE_PCM
	help
	  This adds support for ASoC machine driver for SEMI_DRIVE X9
	  platforms with internal audio codec and speaker amplifier.
	  Select Y if you have such device.
	  If unsure select "N".

config SND_X9_EVB_MACH
	tristate "ASoC Audio driver for evb platform x9"
	depends on ARCH_SEMIDRIVE_X9
	select SND_SDRV_AFE_I2S_SC
	select SND_SOC_GENERIC_DMAENGINE_PCM
	help
	  This adds support for ASoC machine driver for SEMI_DRIVE X9
	  platforms with internal audio codec and speaker amplifier.
	  Select Y if you have such device.
	  If unsure select "N".

config SND_X9_REF_MACH
	tristate "ASoC Audio driver for ref platform x9 with ak7738"
	depends on ARCH_SEMIDRIVE_X9
	select SND_SDRV_AFE_I2S_SC
	select SND_SOC_GENERIC_DMAENGINE_PCM
	help
	  This adds support for ASoC machine driver for SEMI_DRIVE X9
	  platforms with internal audio codec and speaker amplifier.
	  Select Y if you have such device.
	  If unsure select "N".

config SND_X9_REF_MACH_HS
	tristate "ASoC Audio driver for ref platform x9 with headset codec"
	depends on ARCH_SEMIDRIVE_X9
	select SND_SDRV_AFE_I2S_SC
	select SND_SOC_GENERIC_DMAENGINE_PCM
	help
	  This adds support for ASoC machine driver for SEMI_DRIVE X9
	  platforms with internal audio codec and headset amplifier.
	  Select Y if you have such device.
	  If unsure select "N".

config SND_X9_REF_MACH_TLV320AIC23
	tristate "ASoC Audio driver for ref platform x9 with headset codec tlv320aic23"
	depends on ARCH_SEMIDRIVE_X9
	select SND_SDRV_AFE_I2S_SC
	select SND_SOC_GENERIC_DMAENGINE_PCM
	help
	  This adds support for ASoC machine driver for SEMI_DRIVE X9
	  platforms with internal audio codec and headset amplifier.
	  Select Y if you have such device.
	  If unsure select "N".

config SND_G9_REF_MACH
	tristate "ASoC Audio driver for g9 platform"
	depends on ARCH_SEMIDRIVE_G9
	select SND_SOC_GENERIC_DMAENGINE_PCM
	help
	  This adds support for ASoC machine driver for SEMI_DRIVE G9
	  platforms with internal audio codec and speaker amplifier.
	  Select Y if you have such device.
	  If unsure select "N".

config SND_X9_CS42888
	tristate "ASoC Audio driver for x9 with cs24888 codec"
	depends on ARCH_SEMIDRIVE_X9
	select SND_SDRV_AFE_I2S_SC
	select SND_SOC_GENERIC_DMAENGINE_PCM
	help
	  This adds support for ASoC machine driver for SEMI_DRIVE X9
	  platforms with internal audio codec and speaker amplifier.
	  Select Y if you have such device.
	  If unsure select "N".

endmenu
```
